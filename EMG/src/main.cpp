// Include knihoven
#include <Arduino.h>
#include <SPI.h>
#include <Wire.h>
#include <Adafruit_GFX.h>
#include <Adafruit_SSD1306.h>
#include <Adafruit_I2CDevice.h>
#include <U8glib.h>
#include "avdweb_AnalogReadFast.h"

// Display nastaveni
#define SCREEN_WIDTH 128 // OLED display width, in pixels
#define SCREEN_HEIGHT 64 // OLED display height, in pixels
#define OLED_RESET 4
Adafruit_SSD1306 OLED(SCREEN_WIDTH, SCREEN_HEIGHT, &Wire, OLED_RESET);

#define BUZZER 7

int frekvence = 700;

// flagy
int S_flag;
int D_flag;
int H_flag = 1;

bool vypis;

char zprava;

unsigned long startMillis;  //some global variables available anywhere in the program
unsigned long currentMillis;
const unsigned long period = 1000;  //the value is a number of milliseconds

const byte numChars = 32;
char receivedChars[numChars]; // an array to store the received data
boolean newData = false;
int dataNumber = 0; // new for this version
int usb_message;
int flag;
int stop_flag;

void OLEDtext(String text, int x, int y, int size, boolean d);
void OLEDclear();
void OLEDstartup_menu();
void beep_on(int pwm);
void beep_off();
void peep(int frekvence, int delka_tonu);

void peep(int frekvence, int delka_tonu)
{
	pinMode(BUZZER, OUTPUT);
	tone(BUZZER, frekvence);
	delay(delka_tonu);
	noTone(BUZZER);
	pinMode(BUZZER, INPUT);
}

// 'EKG_startup', 127x64px
const unsigned char BMP_EMG_startup [] PROGMEM = {
	0x00, 0x00, 0x00, 0x00, 0x00, 0x00, 0x00, 0x00, 0x00, 0x00, 0x00, 0x00, 0x00, 0x00, 0x00, 0x00, 
	0x00, 0x00, 0x00, 0x00, 0x00, 0x00, 0x00, 0x00, 0x00, 0x00, 0x00, 0x00, 0x00, 0x00, 0x00, 0x00, 
	0x00, 0x00, 0x00, 0x00, 0x00, 0x00, 0x00, 0x00, 0x00, 0x00, 0x00, 0x00, 0x00, 0x00, 0x00, 0x00, 
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	0x00, 0x00, 0x00, 0x00, 0x00, 0x00, 0x00, 0x00, 0x00, 0x00, 0x00, 0x00, 0x00, 0x00, 0x00, 0x00
};

// 'connect', 128x64px
const unsigned char BMP_connect[] PROGMEM = {
	0x00, 0x00, 0x00, 0x00, 0x00, 0x00, 0x00, 0x00, 0x00, 0x00, 0x00, 0x00, 0x00, 0x00, 0x00, 0x00,
	0x00, 0x00, 0x00, 0x00, 0x00, 0x00, 0x00, 0x00, 0x00, 0x00, 0x00, 0x00, 0x00, 0x00, 0x00, 0x00,
	0x00, 0x00, 0x00, 0x00, 0x00, 0x00, 0x00, 0x00, 0x00, 0x00, 0x00, 0x00, 0x00, 0x00, 0x00, 0x00,
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	0x00, 0x00, 0x00, 0x00, 0x00, 0x00, 0x00, 0x00, 0x00, 0x00, 0x00, 0x00, 0x00, 0x00, 0x00, 0x00};

// 'mereni', 128x64px
const unsigned char BMP_EMG_mereni [] PROGMEM = {
	0x00, 0x00, 0x00, 0x00, 0x00, 0x00, 0x00, 0x00, 0x00, 0x00, 0x00, 0x00, 0x00, 0x00, 0x00, 0x00, 
	0x00, 0x00, 0x00, 0x00, 0x00, 0x00, 0x00, 0x00, 0x00, 0x00, 0x00, 0x00, 0x00, 0x00, 0x00, 0x00, 
	0x00, 0x00, 0x00, 0x00, 0x00, 0x00, 0x00, 0x00, 0x00, 0x00, 0x00, 0x00, 0x00, 0x00, 0x00, 0x00, 
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	0x00, 0x00, 0x00, 0x00, 0x00, 0x00, 0x00, 0x00, 0x00, 0x00, 0x00, 0x00, 0x00, 0x00, 0x00, 0x00
};

void OLEDtext(String text, int x, int y, int size, boolean d)
{
  //Výpis textu na OLED, Využívá knihovny Adafruit pro mikrořadič SSD 1306
  OLED.setTextSize(size);
  OLED.setTextColor(WHITE);
  OLED.setCursor(x, y);
  OLED.println(text);
  if (d)
  {
    OLED.display();
  }

  delay(100);
}

void OLEDclear()
{
	// Vyčíštění OLED
	OLED.clearDisplay();
	OLEDtext("", 0, 0, 1, true);
}

void OLEDstartup_menu()
{

	OLEDclear();
	OLED.drawBitmap(0, 0, BMP_EMG_startup, 128, 64, WHITE);
	OLED.display();

	//originálně 5000
	delay(1000);
}

void beep_on(int pwm)
{
	pinMode(BUZZER, OUTPUT);
	tone(BUZZER, pwm);
}

void beep_off()
{
	noTone(BUZZER);
	pinMode(BUZZER, INPUT);
}

// Čtení USB komunikace
void USB_read()
{
	static byte ndx = 0;
	char endMarker = '\n';
	char rc;

	if (Serial.available() > 0)
	{
		rc = Serial.read();

		if (rc != endMarker)
		{
			receivedChars[ndx] = rc;
			ndx++;
			if (ndx >= numChars)
			{
				ndx = numChars - 1;
			}
		}
		else
		{
			receivedChars[ndx] = '\0'; // terminate the string
			ndx = 0;
			newData = true;
		}
	}

	if (newData == true)
	{
		dataNumber = 0;					  // new for this version
		dataNumber = atoi(receivedChars); // new for this version
		// Serial.println(receivedChars)
		usb_message = dataNumber;
		newData = false;
	}
}

void setup()
{
	// put your setup code here, to run once:

	Serial.begin(500000);
	OLED.begin(SSD1306_SWITCHCAPVCC, 0x3C);

	OLED.dim(true); // Snížení jasu OLED

	vypis = true;


	OLEDclear();
	OLED.drawBitmap(0, 0, BMP_EMG_startup, 128, 64, WHITE);
	OLED.display();

	peep(500,150);
	peep(800,150);
	peep(1000,150);

	//originálně 5000, změna kvůli vývoji
	delay(1000);
}

void loop()
{
	if (vypis)
	{
		OLEDclear();
		OLED.drawBitmap(0, 0, BMP_connect, 128, 64, WHITE);
		OLED.display();

		peep(1000,150);
		peep(1000,150);

		vypis = false;
	}

	// čtení bufferu
	if (Serial.available() > 0)
	{
		usb_message = 0;
		USB_read();
		zprava = usb_message;
		// delay(1);

		if (zprava == 2) //Setting
		{
			//implement period change protocol
		}
		if(zprava == 3)
		{
			if ((digitalRead(10) == 1) || (digitalRead(11) == 1)) //Data threshold detection
			{
				// send zero then time 
				Serial.println('0');
			}
			else
			{
				// send data then time 
				Serial.println(analogReadFast(A0));    //this mby saves time idk anymore (100us to 20us)
				// //Serial.write('\r'); -- use to get it to work faster	
			}
		}
		if (zprava == 4) //Stop sending
		{
			S_flag = 0;
			vypis = true;
			Serial.println('P');
		}
		if (zprava == 8) //Handshake
		{
			Serial.println('C');
		}
		if (zprava == 5) //Start sending
		{
			S_flag = 1;
			vypis = true;

			// ACK
			Serial.println('S');
			
			
			if (vypis)
			{
				OLEDclear();
				OLED.drawBitmap(0, 0, BMP_EMG_mereni, 128, 64, WHITE);
				OLED.display();

				peep(1000,150);
				peep(1200,150);

				vypis = false;
			}
			delay(1);
		}
	}
	while (S_flag) //NOTE: might change this while to if for cleaner code, for now it stays
	{
		
		if (Serial.available() > 0) //quick check 
		{
			break;
		}
		currentMillis = micros();  //get the current "time" (actually the number of milliseconds since the program started)
		if (!(currentMillis - startMillis >= period))  //test whether the period has elapsed
		{
			continue;
		}
		startMillis = currentMillis;  //reseting loop (havent found a way to make it perfectly time period)
		if ((digitalRead(10) == 1) || (digitalRead(11) == 1)) //Data threshold detection
		{
			// send zero then time 
			Serial.print('0');
			Serial.print(',');
			Serial.println(currentMillis);
		}
		else
		{
			// send data then time 
			Serial.print(analogReadFast(A0));    //this mby saves time idk anymore (100us to 20us)
			Serial.print(',');					 //FIX- making the print on one line
			Serial.println(currentMillis);
			 // //Serial.write('\r'); -- use to get it to work faster								
		}
	}
}